## wojtech-rpi2/conf/bblayers.conf
```bitbake
# POKY_BBLAYERS_CONF_VERSION is increased each time build/conf/bblayers.conf
# changes incompatibly
POKY_BBLAYERS_CONF_VERSION = "2"

BBPATH = "${TOPDIR}"
BBFILES ?= ""

BBLAYERS ?= " \
  /home/ibisdev/poky/meta \
  /home/ibisdev/poky/meta-poky \
  /home/ibisdev/poky/meta-yocto-bsp \
  /home/ibisdev/poky/meta-raspberrypi \
  /home/ibisdev/poky/meta-openembedded/meta-networking \
  /home/ibisdev/poky/meta-openembedded/meta-python \
  /home/ibisdev/poky/meta-openembedded/meta-oe \
  "
```
